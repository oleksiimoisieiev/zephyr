## CMakeLists.txt
```
# SPDX-License-Identifier: Apache-2.0

cmake_minimum_required(VERSION 3.20.0)
find_package(Zephyr REQUIRED HINTS $ENV{ZEPHYR_BASE})
project(tee_test)

FILE(GLOB app_sources src/*.c)
target_sources(app PRIVATE ${app_sources})
zephyr_include_directories(include)
```

## prj.conf
```kconfig
CONFIG_ZTEST=y
CONFIG_ZTEST_NEW_API=y
CONFIG_BOOT_BANNER=n
CONFIG_DEBUG=y
CONFIG_HEAP_MEM_POOL_SIZE=270044
```

## boards/native_posix_64.overlay
```dts
/ {
	firmware {
		 tee {
		       compatible = "test,tee";
		       method = "smc";
		       status = "okay";
		 };
  	};
};
```

## src/main.c
```c
/*
 * Copyright (c) 2023 Epam Systems
 *
 * SPDX-License-Identifier: Apache-2.0
 */

/**
 * @addtogroup t_driver_xen
 * @{
 * @defgroup t_xen_regions test_xen_regions_operations
 * @}
 */

#include <zephyr/kernel.h>
#include <zephyr/ztest.h>
#include <zephyr/device.h>

#include <zephyr/drivers/tee.h>

ZTEST(tee_test_suite, test_basic_calls)
{
	int ret;
	uint32_t session_id;
	int addr;
	struct tee_shm *shm = NULL;
	const struct device *const dev = DEVICE_DT_GET_ONE(test_tee);

	zassert_not_null(dev, "Unable to get dev");

	ret = tee_get_version(dev, NULL);
	zassert_ok(ret, "tee_get_version failed with code %d", ret);

	ret = tee_open_session(dev, NULL, 0, NULL, &session_id);
	zassert_ok(ret, "tee_open_session failed with code %d", ret);

	ret = tee_close_session(dev, 0);
	zassert_ok(ret, "close_session failed with code %d", ret);

	ret = tee_cancel(dev, 0, 0);
	zassert_ok(ret, "tee_cancel failed with code %d", ret);

	ret = tee_invoke_func(dev, NULL, 0, NULL);
	zassert_ok(ret, "tee_invoke_func failed with code %d", ret);

	ret = tee_shm_register(dev, &addr, 1, 0, &shm);
	zassert_ok(ret, "tee_shm_register failed with code %d", ret);

	ret = tee_shm_unregister(dev, shm);
	zassert_ok(ret, "tee_shm_unregister failed with code %d", ret);

	ret = tee_shm_alloc(dev, 1, 0, &shm);
	zassert_ok(ret, "tee_shm_alloc failed with code %d", ret);

	ret = tee_shm_free(dev, shm);
	zassert_ok(ret, "tee_shm_free failed with code %d", ret);

	ret = tee_suppl_recv(dev, 0, 0, NULL);
	zassert_ok(ret, "tee_suppl_recv failed with code %d", ret);

	ret = tee_suppl_send(dev, 0, NULL);
	zassert_ok(ret, "tee_suppl_send failed with code %d", ret);
}

ZTEST(tee_test_suite, test_reg_unreg)
{
	int ret;
	int addr;
	struct tee_shm *shm = NULL;
	const struct device *const dev = DEVICE_DT_GET_ONE(test_tee);

	zassert_not_null(dev, "Unable to get dev");

	/* Fail pass */
	ret = tee_shm_register(dev, &addr, 1, 0, NULL);
	zassert_equal(ret, -EINVAL, "tee_shm_register failed with code %d", ret);

	ret = tee_shm_register(dev, NULL, 1, 0, &shm);
	zassert_equal(ret, -ENOMEM, "tee_shm_register failed with code %d", ret);

	ret = tee_shm_register(dev, &addr, 1, 0, NULL);
	zassert_equal(ret, -EINVAL, "tee_shm_register failed with code %d", ret);

	ret = tee_shm_register(dev, &addr, 0, 0, &shm);
	zassert_equal(ret, 0, "tee_shm_register failed with code %d", ret);

	ret = tee_shm_unregister(dev, NULL);
	zassert_equal(ret, -EINVAL, "tee_shm_unregister failed with code %d", ret);

	/* Happy pass */
	ret = tee_shm_register(dev, &addr, 1, 0, &shm);
	zassert_ok(ret, "tee_shm_register failed with code %d", ret);

	ret = tee_shm_unregister(dev, shm);
	zassert_ok(ret, "tee_shm_unregister failed with code %d", ret);

	ret = tee_shm_alloc(dev, 1, 0, &shm);
	zassert_ok(ret, "tee_shm_alloc failed with code %d", ret);

	ret = tee_shm_free(dev, shm);
	zassert_ok(ret, "tee_shm_free failed with code %d", ret);
}

ZTEST_SUITE(tee_test_suite, NULL, NULL, NULL, NULL, NULL);
```

## src/test_tee.c
```c
/*
 * Copyright 2023 Epam Systems
 *
 * SPDX-License-Identifier: Apache-2.0
 */

#include <zephyr/drivers/tee.h>
#include <zephyr/logging/log.h>

LOG_MODULE_REGISTER(test_tee);

#define DT_DRV_COMPAT test_tee

static int test_tee_get_version(const struct device *dev, struct tee_version_info *info)
{
	printk("%s %d\n", __func__, __LINE__);
	return 0;
}

static int test_tee_open_session(const struct device *dev, struct tee_open_session_arg *arg,
				 unsigned int num_param, struct tee_param *param,
				 uint32_t *session_id)
{
	printk("%s %d\n", __func__, __LINE__);
	return 0;
}

static int test_tee_close_session(const struct device *dev, uint32_t session_id)
{
	printk("%s %d\n", __func__, __LINE__);
	return 0;
}

static int test_tee_cancel(const struct device *dev, uint32_t session_id, uint32_t cancel_id)
{
	printk("%s %d\n", __func__, __LINE__);
	return 0;
}

static int test_tee_invoke_func(const struct device *dev, struct tee_invoke_func_arg *arg,
				unsigned int num_param, struct tee_param *param)
{
	printk("%s %d\n", __func__, __LINE__);
	return 0;
}

static int test_tee_shm_register(const struct device *dev, struct tee_shm *shm)
{
	printk("%s %d\n", __func__, __LINE__);
	return 0;
}

static int test_tee_shm_unregister(const struct device *dev, struct tee_shm *shm)
{
	printk("%s %d\n", __func__, __LINE__);
	return 0;
}

static int test_tee_suppl_recv(const struct device *dev, uint32_t func, unsigned int num_params,
			       struct tee_param *param)
{
	printk("%s %d\n", __func__, __LINE__);
	return 0;
}

static int test_tee_suppl_send(const struct device *dev, unsigned int num_params,
			       struct tee_param *param)
{
	printk("%s %d\n", __func__, __LINE__);
	return 0;
}

static int test_tee_init(const struct device *dev)
{
	printk("%s %d\n", __func__, __LINE__);

	return 0;
}

static const struct tee_driver_api test_tee_driver_api = {
	.get_version = test_tee_get_version,
	.open_session = test_tee_open_session,
	.close_session = test_tee_close_session,
	.cancel = test_tee_cancel,
	.invoke_func = test_tee_invoke_func,
	.shm_register = test_tee_shm_register,
	.shm_unregister = test_tee_shm_unregister,
	.suppl_recv = test_tee_suppl_recv,
	.suppl_send = test_tee_suppl_send,
};

DEVICE_DT_INST_DEFINE(0, test_tee_init, NULL, NULL, NULL, POST_KERNEL,
		      CONFIG_KERNEL_INIT_PRIORITY_DEVICE, &test_tee_driver_api);
```
