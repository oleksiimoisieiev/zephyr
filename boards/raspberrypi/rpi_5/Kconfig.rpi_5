## boards/raspberrypi/rpi_5/Kconfig.rpi_5
```kconfig
# Copyright 2024 Junho Lee <junho@tsnlab.com>
# SPDX-License-Identifier: Apache-2.0

config BOARD_RPI_5
	select SOC_BCM2712

if DISK_DRIVER_SDMMC

config SD_CMD_TIMEOUT
        default 1000

endif
```
