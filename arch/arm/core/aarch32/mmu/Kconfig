## dts/bindings/pinctrl/renesas,rza2.yaml
```yaml
# Copyright (c) 2023 Epam Systems
# SPDX-License-Identifier: Apache-2.0

description: |
    Renesas RZ/A2 compined Pin Function and GPIO Controller node
    Pin multiplexing and GPIO configuration is performed on a per-pin basis.
    Each port features up to 8 pins, each of them configurable for GPIO function
    (port mode) or in alternate function mode.
    Up to 8 different alternate function modes exist for each single pin.

compatible: "renesas,r7s9210-pinctrl"

include: base.yaml

properties:
  reg:
    required: true

  reg-names:
    required: true

child-binding:
  description: |
     This binding gives a base representation of the RZ/A2 pinmux configuration
     and GPIO ports description.

  include:
    - name: pincfg-node.yaml

  properties:
    pinmux:
      type: array
      required: true
      description: |
        Values are constructed from GPIO port number, pin number, and
        alternate function configuration number using the RZA2_PINMUX()
        helper macro in pinctrl-r7s9210.h.

    drive-strength:
      type: int
      enum:
        - 1 # 8 mA
        - 2 # 12 mA
      description: |
        The PCKIO register controls driving ability of the CKIO pin.
```

## dts/bindings/watchdog/renesas,rza-wdt.yaml
```yaml
# Copyright (c) 2023 EPAM Systems
# SPDX-License-Identifier: Apache-2.0

description: Renesas RZ A Watchdog

compatible: "renesas,rza-wdt"

include: [base.yaml, pinctrl-device.yaml]

properties:
  reg:
    required: true

  clocks:
    required: true

  pinctrl-0:
    description: |
      Pinconfig setting of WDTOVF pin. The WDTOVF pin is used in watchdog timer
      mode to output the WDTOVF signal when the WTCNT overflows. The WDTOVF
      signal is externally output for 64 × P0φ clock cycles. Unfortunately, the
      RZ A2M EVK board utilizes all available WDTOVF outputs for other functions.
```

## samples/drivers/i2s/wm8978/Kconfig
```kconfig
# Private config options for can sample app

# Copyright (c) 2018 Alexander Wachter
# SPDX-License-Identifier: Apache-2.0

mainmenu "WM8978 loopback"

config WM8978_ANALOG_LOOPBACK
	bool "Analog loopback mode"
	default n
	help
	  Set the codec to loopback mode.
	  This connects input line to output line.

config WM8978_MIXER
	bool "Mix input signal with DAC output"
	default n
	depends on WM8978_ANALOG_LOOPBACK
	help
	  Mix input signal with DAC output

if !WM8978_ANALOG_LOOPBACK
config WM8978_LOOPBACK
	bool "Loopback mode"
	default n
	help
	  Set the codec to loopback mode.
	  This connects ADC to DAC.
endif

source "Kconfig.zephyr"
```

## soc/arm/renesas_rz/Kconfig
```kconfig
# Renesas RZ SoC line

# Copyright (c) 2023 EPAM Systems
# SPDX-License-Identifier: Apache-2.0

config SOC_FAMILY_RZ
	bool

if SOC_FAMILY_RZ

config SOC_FAMILY
	string
	default "renesas_rz"

source "soc/arm/renesas_rz/*/Kconfig.soc"

endif # SOC_FAMILY_RZ
```

## soc/arm/renesas_rz/Kconfig.defconfig
```kconfig
# Copyright (c) 2023 EPAM Systems
# SPDX-License-Identifier: Apache-2.0

source "soc/arm/renesas_rz/*/Kconfig.defconfig.series"
```

## soc/arm/renesas_rz/rz_a/Kconfig.defconfig.r7s9210
```kconfig
# Copyright (c) 2023 EPAM Systems
# SPDX-License-Identifier: Apache-2.0

if SOC_R7S9210

config SOC
	default "r7s9210"

endif # SOC_R7S9210
```

## soc/arm/renesas_rz/rz_a/Kconfig.defconfig.series
```kconfig
# Renesas RZ A2M SoC line

# Copyright (c) 2023 EPAM Systems
# SPDX-License-Identifier: Apache-2.0

if SOC_SERIES_RZ_A

config SOC_SERIES
	default "rz_a"

config NUM_IRQS
	default 520 if 2ND_LEVEL_INTERRUPTS
	default 512 if !2ND_LEVEL_INTERRUPTS

if MULTI_LEVEL_INTERRUPTS

config 1ST_LEVEL_INTERRUPT_BITS
	default 9

config MAX_IRQ_PER_AGGREGATOR
	default 8

config 2ND_LEVEL_INTERRUPTS
	default y

config 2ND_LVL_ISR_TBL_OFFSET
	default 512

config 2ND_LVL_INTR_00_OFFSET
	default 4

config NUM_2ND_LEVEL_AGGREGATORS
	default 1

endif # MULTI_LEVEL_INTERRUPTS

# we want to get correct flash size and address even if XIP is disabled
config FLASH_SIZE
	default $(dt_chosen_reg_size_int,$(DT_CHOSEN_Z_FLASH),0,K)

config FLASH_BASE_ADDRESS
	default $(dt_chosen_reg_addr_hex,$(DT_CHOSEN_Z_FLASH))

endif # SOC_SERIES_RZ_A
```

## soc/arm/renesas_rz/rz_a/Kconfig.series
```kconfig
# Copyright (c) 2023 EPAM Systems
# SPDX-License-Identifier: Apache-2.0

config SOC_SERIES_RZ_A
	bool "Renesas RZ A series based on Cortex A9"
	select ARM
	select CPU_CORTEX_A9
	select PLATFORM_SPECIFIC_INIT
	select SOC_FAMILY_RZ
	help
	  Enable support for Renesas RZ A SoC series based on Cortex A-9

if SOC_SERIES_RZ_A

config ARM_HAS_GLOBAL_MONITOR
	default n
	help
	  Cortex A9 reference manual says (ARM DDI 0388G):
	  The L1 memory system of the Cortex-A9 processor has a local monitor. This is a 2-state, open
	  and exclusive, state machine that manages load/store exclusive (LDREXB, LDREXH, LDREX, LDREXD,
	  STREXB, STREXH, STREX and STREXD) accesses and clear exclusive (CLREX) instructions.

	  At the same time L2 cache PL310 reference manual says (ARM DDI 0246H):
	  The cache controller supports cacheable and non-cacheable exclusive accesses but does not
	  provide an exclusive monitor. The system integrator must implement external exclusive
	  monitors as follows, so that the cache controller can return an EXOKAY response.

	  And, finally, "RZ/A2M Group User’s Manual: Hardware" (R01UH0746EJ0400 Rev.4.00) says:
	  This LSI does not support atomic access. This restriction means that instructions for
	  exclusive access (LDREX, STREX, LDREXB, STREXB, LDREXD, STREXD, LDREXH, STREXH) and semaphore
	  instructions (SWP, SWPB) cannot be used by the Cortex-A9 in the internal non-cacheable areas.

	  From the previous explanations, it's evident that only the L1 cache has the local monitor,
	  allowing us to utilize exclusive operations solely on cached memory within L1 that lacks the
	  Shareable attribute. For further details, you can refer to the description of the
	  corresponding configuration for ARM32 MMU.

endif # SOC_SERIES_RZ_A
```

## soc/arm/renesas_rz/rz_g/Kconfig.defconfig.r9r08g045
```kconfig
# Copyright (c) 2024 EPAM Systems
# SPDX-License-Identifier: Apache-2.0

if SOC_R9A08G045

config SOC
	default "r9a08g045"

endif # SOC_R9A08G045
```

## soc/arm/renesas_rz/rz_g/Kconfig.defconfig.series
```kconfig
# Renesas RZ G3S SoC line

# Copyright (c) 2024 EPAM Systems
# SPDX-License-Identifier: Apache-2.0

if SOC_SERIES_RZ_G

config SOC_SERIES
	default "rz_g"

config NUM_IRQS
	default 480

endif # SOC_SERIES_RZ_G
```
