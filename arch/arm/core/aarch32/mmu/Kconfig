## arch/arm/core/aarch32/mmu/Kconfig
```kconfig
#
# ARMv7 Memory Management Unit (MMU) configuration options
#
# Copyright (c) 2021 Weidmueller Interface GmbH & Co. KG
# SPDX-License-Identifier: Apache-2.0
#

if CPU_HAS_MMU

config ARM_AARCH32_MMU
	bool "ARMv7 Cortex-A MMU Support"
	default y if CPU_AARCH32_CORTEX_A
	select MMU
	select SRAM_REGION_PERMISSIONS
	select THREAD_STACK_INFO
	select ARCH_HAS_EXECUTABLE_PAGE_BIT
	help
	  The current CPU has an ARMv7 Memory Management Unit.

config ARM_MMU_NUM_L2_TABLES
	depends on ARM_AARCH32_MMU
	int "Number of L2 translation tables available to the MMU"
	default 64
	help
	  Number of level 2 translation tables. Each level 2 table
	  covers 1 MB of address space.

config ARM_MMU_REGION_MIN_ALIGN_AND_SIZE
	int
	default 4096
	help
	  Minimum size (and alignment) of an ARM MMU page.
	  This value should not be modified.

config ARM_HAS_GLOBAL_MONITOR
	depends on ARM_AARCH32_MMU
	bool "ARMv7 Cortex A has global monitor or not"
	default y
	help
	  The Shareable attribute of memory can lead to the failure of exclusive operations in cases
	  where the Global Monitor isn't implemented. To ensure successful execution of exclusive
	  operations, it's necessary to disable the effects of the shareable attribute on such systems,
	  see ARM DDI 0406C.d Exclusive access instructions and Non-shareable memory regions:
	  For memory regions that do not have the Shareable attribute, the exclusive access
	  instructions rely on a local monitor that tags any address from which the processor executes
	  a Load-Exclusive.

	  ARM DDI 0406C.d Exclusive access instructions and Shareable memory regions:
	  For memory regions that have the Shareable attribute, exclusive access instructions rely on:
	  a global monitor that tags a physical address as exclusive access for a particular processor.

	  The global monitor can either reside in a processor block or exist as a secondary monitor at
	  the memory interfaces.

	  The global monitor only supports a single outstanding exclusive access to Shareable memory per
	  processor.

	  It is IMPLEMENTATION DEFINED whether the system includes a Global Monitor. If the system only
	  has a Local Monitor, and the Local Monitor doesn't function as a Global Monitor (i.e., they
	  aren't combined), and memory is marked as "Shareable," this configuration can result in the
	  failure of exclusive operations on these systems. Therefore, it's recommended to refrain from
	  applying the shareable attribute to memory on such systems.


endif # CPU_HAS_MMU
```

## boards/arm/rz_a2m/Kconfig.board
```kconfig
# Copyright (c) 2023 EPAM Systems
# SPDX-License-Identifier: Apache-2.0

config BOARD_RZ_A2M
	bool "Cortex-A9 for Renesas RZ A2M"
	depends on SOC_R7S9210
```

## boards/arm/rz_a2m/rz_a2m_defconfig
```kconfig
CONFIG_SOC_R7S9210=y
CONFIG_SOC_SERIES_RZ_A=y
CONFIG_BOARD_RZ_A2M=y

# dummy value, runtime value will be used from 'renesas,ostm' timer driver
CONFIG_SYS_CLOCK_HW_CYCLES_PER_SEC=33000000

# Enable clock control
CONFIG_CLOCK_CONTROL=y

# Enable UART driver
CONFIG_SERIAL=y

# Enable console
CONFIG_CONSOLE=y
CONFIG_UART_CONSOLE=y
```

## boards/arm/rz_g3s/Kconfig.board
```kconfig
# Copyright (c) 2024 EPAM Systems
# SPDX-License-Identifier: Apache-2.0

config BOARD_RZ_G3S
	bool "Cortex-M33 for Renesas RZ G3S"
	depends on SOC_R9A08G045
```

## boards/arm/rz_g3s/Kconfig.defconfig
```kconfig
# Copyright (c) 2024 EPAM Systems
# SPDX-License-Identifier: Apache-2.0

if BOARD_RZ_G3S
config BOARD
	default "rz_g3s"

endif # BOARD_RZ_G3S
```

## boards/arm/rz_g3s/rz_g3s_defconfig
```kconfig
CONFIG_SOC_R9A08G045=y
CONFIG_SOC_SERIES_RZ_G=y
CONFIG_BOARD_RZ_G3S=y

# dummy value, runtime value will be used from 'renesas,ostm' timer driver
CONFIG_SYS_CLOCK_HW_CYCLES_PER_SEC=250000000

CONFIG_FLASH_SIZE=0
CONFIG_FLASH_BASE_ADDRESS=0

CONFIG_XIP=n
```

## drivers/clock_control/Kconfig.renesas
```kconfig
# Copyright (c) 2021-2022 IoT.bzh
# Copyright (c) 2023 EPAM Systems
# SPDX-License-Identifier: Apache-2.0

config CLOCK_CONTROL_RENESAS_CPG_MSSR
	bool "Renesas CPG MSSR driver"
	default y
	depends on DT_HAS_RENESAS_R8A7795_CPG_MSSR_ENABLED || DT_HAS_RENESAS_R7S9210_CPG_MSSR_ENABLED
	help
	  Enable support for Renesas RCar CPG MSSR driver.
```

## drivers/gpio/Kconfig.rza2
```kconfig
# Renesas RZA2 configuration options

# Copyright (c) 2023 EPAM Systems
# SPDX-License-Identifier: Apache-2.0

config GPIO_RZA2
	bool "Renesas RZA2 GPIO port"
	default y
	depends on DT_HAS_RENESAS_R7S9210_GPIO_PORT_ENABLED
	select PINCTRL
	help
	  Enable Renesas RZA2 GPIO driver.

if GPIO_RZA2

config GPIO_RZA2_PORT_INIT_PRIORITY
	int "RZA2 GPIO port init priority"
	default 40
	help
	  Device driver initialization priority. The priority should be lower
	  than PINCTRL_RZA2_INIT_PRIORITY device.

endif #GPIO_RZA2
```

## drivers/pinctrl/Kconfig.rza2
```kconfig
# Copyright (c) 2021 IoT.bzh
# SPDX-License-Identifier: Apache-2.0

config PINCTRL_RZA2
	bool "Pin controller driver for Renesas RZA2 series"
	default y
	depends on DT_HAS_RENESAS_R7S9210_PINCTRL_ENABLED
	help
	  Enable pin controller driver for Renesas RZA2

if PINCTRL_RZA2

config PINCTRL_RZA2_INIT_PRIORITY
	int "RZA2 pinctrl init priority"
	default 35
	help
	  Device driver initialization priority.

endif #PINCTRL_RZA2
```

## drivers/tee/Kconfig
```kconfig
# Copyright (c) 2023 Epam Systems
# SPDX-License-Identifier: Apache-2.0

menuconfig TEE
	bool "Trusted Environment Drivers"
	depends on ARM || ARM64 || RISCV || ZTEST
	help
	  Include TEE drivers in system config

if TEE

module = TEE
module-str = tee

comment "Device Drivers"

source "drivers/tee/optee/Kconfig"

endif # TEE
```

## drivers/tee/optee/Kconfig
```kconfig
# Copyright (c) 2023 Epam Systems
# SPDX-License-Identifier: Apache-2.0

config OPTEE
	bool "Enable optee driver in system"
	depends on TEE
	help
	  Enable OPTEE connection driver in the system
```

## dts/bindings/bsc/renesas,rza2-bsc.yaml
```yaml
# Copyright (c) 2023 Epam Systems
# SPDX-License-Identifier: Apache-2.0

description: |
  The bus state controller outputs control signals for various types of
  memory and external devices that are connected to the external address
  space. The functions of this module enable this LSI to connect directly
  with SRAM, SDRAM, and other memory storage devices, and external devices.

compatible: "renesas,rza2-bsc"

include: base.yaml

properties:
  reg:
    required: true

  "#address-cells":
    const: 1

  "#size-cells":
    const: 0

child-binding:
  description: |
    LSI has 32-bit address space, divided into external memory spaces according to the upper
    bits of address:
      H'00000000 to H'03FFFFFF CS0 Normal space, SRAM with byte selection,
                 burst ROM (asynchronous or synchronous)
      H'04000000 to H'07FFFFFF CS1 Normal space, SRAM with byte selection
      H'08000000 to H'0BFFFFFF CS2 Normal space, SRAM with byte selection, SDRAM
      H'0C000000 to H'0FFFFFFF CS3 Normal space, SRAM with byte selection, SDRAM
      H'10000000 to H'13FFFFFF CS4 Normal space, SRAM with byte selection, burst ROM (asynchronous)
      H'14000000 to H'17FFFFFF CS5 Normal space, SRAM with byte selection, MPX-I/O
      H’1F000000 to H’8FFFFFFF Others On-chip peripheral module, SPI multi I/O bus space,
                 HyperFlash TM / HyperRAM TM space, OctaFlash TM / OctaRAM TM space, on-chip
                 large-capacity RAM, on-chip data retention RAM, reserved area.
    Each node represets one Address area with the selected memory type.

  include: pinctrl-device.yaml

  properties:
    reg:
      type: int
      required: true
      description: Area identifier.

    type:
      type: int
      required: true
      enum:
        - 0 # Normal Memory
        - 1 # Burst Async
        - 2 # MPX_IO
        - 3 # SRAM Byte Select
        - 4 # SDRAM
        - 5 # Burst Sync
      description: Memory type.

    pinctrl-0:
      description: |
        Set pin configuration for the Bus State Controller. This is needed to
        control and configure Data and Access busses.

    sw:
      type: int
      enum:
        - 0 # 0.5 cycles
        - 1 # 1.5 cycles
        - 2 # 2.5 cycles
        - 3 # 3.5 cycles
      description: Number of Delay Cycles from Address.

    hw:
      type: int
      enum:
        - 0 # 0.5 cycles
        - 1 # 1.5 cycles
        - 2 # 2.5 cycles
        - 3 # 3.5 cycles
      description: Delay Cycles from RD#, WEn# Negation to Address.

    iwrrs:
      type: int
      description: |
        Idle Cycles for Read-Read in the Same Space. Please See HW Manual for supported values.

    iwrrd:
      type: int
      description: |
        Idle Cycles for Read-Read in Another Space. Please See HW Manual for supported values.

    idle:
      type: int
      description: Idle time for SDRAM startup sequence. Size uint32.

    sdcs2:
      type: int
      description: set MODE CS2 for SDRAM. Size uint16.

    sdcs3:
      type: int
      description: set MODE CS3 for SDRAM. Size uint16.

    iwrws:
      type: int
      description: Idle Cycles for Read-Write in the Same Space.

    iwrwd:
      type: int
      description: Idle Cycles for Another Space Read-Write

    iww:
      type: int
      description: Idle Cycles between Write-Read Cycles and Write-Write Cycles

    auto_ref:
      type: int
      description: Auto refresh feature. 1 to enable and 0 to disable.

    rtcor:
      type: int
      description: Refresh Timer Constant Register value. Size is uint8.

    rtcnt:
      type: int
      description: Refresh Timer Counter value. Size is uint8.

    cks:
      type: int
      description: |
        Select the clock input to count-up the refresh timer counter (RTCNT).
        See HW manual for allowed values.

    rrc:
      type: int
      enum:
        - 1
        - 2
        - 4
        - 6
        - 8
      description: Specify the number of continuous refresh cycles

    deep:
      type: int
      enum:
        - 0 # Self-refresh mode
        - 1 # Deep power-down mode
      description: Deep Power-Down Mode.

    pwr_down:
      type: int
      description: Set powerdown state.

    bas:
      type: int
      description: SRAM with Byte Selection Byte Access Select.

    bw:
      type: int
      enum:
        - 0 # no cycle
        - 1 # 1 cycle
        - 2 # 2 cycles
        - 3 # 3 cycles
      description: Number of Burst Wait Cycles.

    a2row:
      type: int
      enum:
        - 0 # 11 bits
        - 1 # 12 bits
        - 2 # 13 bits
      description: Number of Bits of Row Address for Area 2.

    a2col:
      type: int
      enum:
        - 0 # 8 bits
        - 1 # 9 bits
        - 2 # 10 bits
      description: Number of Bits of Column Address for Area 2.

    a3col:
      type: int
      enum:
        - 0 # 8 bits
        - 1 # 9 bits
        - 2 # 10 bits
      description: Number of Bits of Column Address for Area 3.

    a3row:
      type: int
      enum:
        - 0 # 11 bits
        - 1 # 12 bits
        - 2 # 13 bits
      description: Number of Bits of Row Address for Area 3.

    bactv:
      type: int
      enum:
        - 0 # Auto-precharge mode
        - 1 # Bank active mode
      description: Bank Active Mode. Can be set only for Area 3.

    wr_wait_cycles:
      type: int
      enum:
        - 0 # No cycle
        - 1
        - 2
        - 3
        - 4
        - 5
        - 6
        - 8
        - 10
        - 12
        - 14
        - 18
        - 24
      description: Number of Access Wait Cycles.

    ww_wait_cycles:
      type: int
      enum:
        - 0 # No cycle
        - 1
        - 2
        - 3
        - 4
        - 5
        - 6
      description: Number of Write Access Wait Cycles.

    wtrcd:
      type: int
      enum:
        - 0 # No cycle
        - 1
        - 2
        - 3
      description: Number of Wait Cycles between ACTV Command and READ(A)/WRIT(A) Command.

    a3cl:
      type: int
      enum:
        - 1 # cycle
        - 2
        - 3
        - 4
      description: CAS Latency for Area 3.

    wtrp:
      type: int
      enum:
        - 0 # No cycle
        - 1
        - 2
        - 3
      description: Number of Auto-Precharge Completion Wait Cycles.

    trwl:
      type: int
      enum:
        - 0 # No cycle
        - 1
        - 2
        - 3
      description: Number of Auto-Precharge Startup Wait Cycles.

    wtrc:
      type: int
      enum:
        - 2 # Cycles
        - 3
        - 5
        - 8
      description: |
       Number of Idle Cycles from REF Command/Self-Refresh Release to ACTV/REF/MRS
       Command.

    a2cl:
      type: int
      enum:
        - 0 # 1 Cycle
        - 1 # 2 Cycles
        - 2 # 3 Cycles
        - 3 # 4 Cycles
      description: CAS Latency for Area 2.

    wm:
      type: int
      enum:
        - 0 # External wait input is valid
        - 1 # External wait input is ignored
      description: External Wait Mask Specification

    bsz:
      type: int
      enum:
        - 8 # 8 bit bus width
        - 16 # 16 bit bus width
      description: |
        Data Bus Width Specification. If area = 5 and type = MEM_MPX_IO then
        this parameter is ignored.

    szsel:
      type: int
      enum:
        - 0 # Selects the bus width by address A14
        - 1 # Selects the bus width by address A21
      description: |
        MPX-I/O Interface Bus Width Specification. This parameter is valid
        only for area = 5 and type = MEM_MPX_IO.

    sdridly:
      type: int
      enum:
        - 0 # The SDRAM is not to be connected.
        - 15 # (0xF). The SDRAM is to be connected.
      description: Input characteristics adjustment bit. Valid only for SDRAM memory type.

    sdrodly:
      type: int
      enum:
        - 0 # The SDRAM is not to be connected.
        - 2 # The SDRAM is to be connected.
      description: Output characteristics adjustment bit. Valid only for SDRAM memory type.
```

## dts/bindings/dma/renesas,rza2-dma.yaml
```yaml
# Copyright (c) 2023, EPAM Systems
# SPDX-License-Identifier: Apache-2.0

description: |
  RZA2 DMA controller

  channel: Select channel for data transmitting

  slot: Select peripheral to connect DMA. Slots defined in rza2_dma.h header.

  config: A 32bit mask specifying the DMA channel configuration

   Example of devicetree configuration

   &ssi0 {
        status = "okay";

        dmas = <&dma0 0 DMA_RXI0 0>, <&dma0 5 DMA_TXI0 0>
        dma-names = "rx", "tx";
   };

compatible: "renesas,rza2-dma"

include: [dma-controller.yaml, pinctrl-device.yaml]

properties:
  reg:
    required: true

  interrupts:
    required: true

  dma-channels:
    required: true

  "#dma-cells":
    const: 3

  dma-buf-addr-alignment:
    required: true

dma-cells:
  - channel
  - slot
  - config
```

## dts/bindings/gpio/renesas,rza2-gpio-port.yaml
```yaml
description: Reneses RZ/A2 GPIO port node

compatible: "renesas,r7s9210-gpio-port"

include: [gpio-controller.yaml, base.yaml]

properties:
  reg:
    required: true
    description: |
      GPIO port number. RZA2 board has a number of ports that
      are used to calculate correct pin number.

  "#gpio-cells":
    const: 2

gpio-cells:
  - pin
  - flags
```

## dts/bindings/gpio/renesas,rza2-gpio.yaml
```yaml
description: Reneses RZ/A2 GPIO node

compatible: "renesas,r7s9210-gpio"

include: base.yaml

properties:
  reg:
    required: true
    description: |
      GPIO region for I/O operations.

  "#address-cells":
    const: 1

  "#size-cells":
    const: 0
```
