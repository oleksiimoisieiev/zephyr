## soc/arm/renesas_rz/rz_g/Kconfig.series
```kconfig
# Copyright (c) 2024 EPAM Systems
# SPDX-License-Identifier: Apache-2.0

config SOC_SERIES_RZ_G
	bool "Renesas RZ A series based on Cortex M33"
	select ARM
	select CPU_CORTEX_M33
	select PLATFORM_SPECIFIC_INIT
	select SOC_FAMILY_RZ
	help
	  Enable support for Renesas RZ G SoC series based on Cortex M33

if SOC_SERIES_RZ_G

endif # SOC_SERIES_RZ_G
```

## soc/arm/renesas_rz/rz_g/Kconfig.soc
```kconfig
# Copyright (c) 2024 EPAM Systems
# SPDX-License-Identifier: Apache-2.0

choice
	prompt "Renesas RZ G3S SoC Selection"
	depends on SOC_SERIES_RZ_G

config SOC_R9A08G045
	bool "R9A08G045"

endchoice
```

## tests/drivers/pinctrl/rz_a2m/testcase.yaml
```yaml
tests:
  drivers.pinctrl.rz_a2m:
    tags:
      - drivers
      - pinctrl
    depends_on:
      - pinctrl
      - rz_a2m
```

## tests/drivers/tee/optee/testcase.yaml
```yaml
tests:
  drivers.tee.optee:
    build_only: false
    tags: tee
    timeout: 500
    integration_platforms:
      - native_posix_64
    platform_allow: native_posix_64
```

## tests/drivers/tee/tee/testcase.yaml
```yaml
tests:
  drivers.tee.tee:
    build_only: false
    tags: tee
    timeout: 500
    integration_platforms:
      - native_posix_64
    platform_allow: native_posix_64
```
